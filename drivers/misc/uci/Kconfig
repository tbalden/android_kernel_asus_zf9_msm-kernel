## drivers/misc/uci/Kconfig
```kconfig
#
# Unprivileged Configuration Interface
#
menu "Unprivileged Configuration Interface"
config UCI
       default y
       tristate "Unprivileged Configuration Interface"

endmenu
```
